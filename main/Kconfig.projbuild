## main/Kconfig.projbuild
```kconfig
menu "Temperature Sensor Configuration"

    config DS18B20_GPIO
        int "DS18B20 data GPIO"
        range 0 48
        default 16
        help
            GPIO connected to the DS18B20 DQ pin. Use an external 4.7K pull-up
            resistor from DQ to 3.3V for reliable 1-Wire communication.

endmenu


menu "PoE Ethernet (W5500) Configuration"

    config ETH_SPI_CLOCK_MHZ
        int "SPI clock speed (MHz)"
        default 10
        help
            SPI clock frequency used to communicate with the W5500.

    config ETH_SPI_SCLK_GPIO
        int "SPI SCLK GPIO"
        default 13

    config ETH_SPI_MOSI_GPIO
        int "SPI MOSI GPIO"
        default 11

    config ETH_SPI_MISO_GPIO
        int "SPI MISO GPIO"
        default 12

    config ETH_SPI_CS_GPIO
        int "SPI CS GPIO"
        default 14

    config ETH_SPI_INT_GPIO
        int "W5500 INT GPIO"
        default 10

    config ETH_SPI_RST_GPIO
        int "W5500 RST GPIO"
        default 09

    config ETH_STATIC_IP_ADDR
        string "Static IP address"
        default "192.168.1.80"

    config ETH_STATIC_GW_ADDR
        string "Static gateway address"
        default "192.168.1.1"

    config ETH_STATIC_NETMASK_ADDR
        string "Static netmask"
        default "255.255.255.0"

endmenu
```
